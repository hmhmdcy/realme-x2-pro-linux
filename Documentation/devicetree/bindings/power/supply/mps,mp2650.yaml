## Documentation/devicetree/bindings/power/supply/mps,mp2650.yaml
```yaml
# SPDX-License-Identifier: GPL-2.0-only OR BSD-2-Clause
%YAML 1.2
---
$id: http://devicetree.org/schemas/power/supply/mps,mp2650.yaml#
$schema: http://devicetree.org/meta-schemas/core.yaml#

title: Monolithic Power Systems MP2650 battery charger

maintainers:
  - Samurai Linux port maintainers <samurai-linux@example.com>

description: |
  The MP2650 is an I2C battery charger. The Samurai driver exposes input
  voltage, input current, input presence, charging status and, when the board
  provides the OTG pin and a usb-otg-vbus child, the standard VBUS regulator
  used by a USB Type-C source port. Charging current, voltage, BATFET and
  protection configuration remain board policy.

allOf:
  - $ref: power-supply.yaml#

properties:
  compatible:
    const: mps,mp2650

  reg:
    maxItems: 1

  otg-gpios:
    description:
      GPIO connected to the MP2650 OTG/CMIN pin. The pin is driven high while
      the OTG boost is enabled.
    maxItems: 1

  usb-otg-vbus:
    $ref: /schemas/regulator/regulator.yaml#
    description:
      Regulator node controlling the MP2650 OTG boost output. The regulator
      enable path releases CHG_EN, asserts REG08.OTG_EN and drives otg-gpios
      high; disable restores the saved REG08 value and drives the pin low.

required:
  - compatible
  - reg

unevaluatedProperties: false

examples:
  - |
    i2c {
        #address-cells = <1>;
        #size-cells = <0>;

        charger@5c {
            compatible = "mps,mp2650";
            reg = <0x5c>;
            otg-gpios = <&gpio 4 GPIO_ACTIVE_HIGH>;

            usb-otg-vbus {
                regulator-name = "mp2650-vbus";
                regulator-min-microvolt = <5000000>;
                regulator-max-microvolt = <5000000>;
                regulator-enable-ramp-delay = <750000>;
            };
        };
    };
```
